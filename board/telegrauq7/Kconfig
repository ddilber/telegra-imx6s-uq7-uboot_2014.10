## board/telegrauq7/Kconfig
```kconfig
if TARGET_TELEGRAUQ7

config SYS_CPU
	default "armv7"

config SYS_BOARD
	default "telegrauq7"

config SYS_SOC
	default "mx6"

config SYS_CONFIG_NAME
	default "telegrauq7"

endif
```

## configs/telegrauq7_solo_defconfig
```kconfig
CONFIG_SYS_EXTRA_OPTIONS="IMX_CONFIG=board/telegrauq7/mx6dl.cfg,MX6S,DDR_MB=256"
CONFIG_ARM=y
CONFIG_TARGET_TELEGRAUQ7=y
```
